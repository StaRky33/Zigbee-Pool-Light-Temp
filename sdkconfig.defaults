## sdkconfig.defaults
```kconfig
CONFIG_ZB_ENABLED=y
CONFIG_ZB_ZED_ROLE=y
CONFIG_ZB_RADIO_NATIVE=y
CONFIG_ZB_GP_ENABLED=n
CONFIG_ESP_DEFAULT_CPU_FREQ_MHZ_160=y
CONFIG_FREERTOS_HZ=1000
CONFIG_ADC_ONESHOT_CTRL_FUNC_IN_IRAM=y
CONFIG_PARTITION_TABLE_CUSTOM=y
CONFIG_PARTITION_TABLE_CUSTOM_FILENAME="partitions.csv"
```
